// SPDX-License-Identifier: (GPL-2.0 OR MIT)

#include "imx8mq-u-boot.dtsi"

&usdhc1 {
	mmc-hs400-1_8v;
};

&usdhc2 {
	sd-uhs-sdr104;
	sd-uhs-ddr50;
};

&fec1 {
	phy-reset-gpios = <&gpio1 9 GPIO_ACTIVE_LOW>;
	phy-reset-duration = <10>;
};
