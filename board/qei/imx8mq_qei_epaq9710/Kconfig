## board/qei/imx8mq_qei_epaq9710/Kconfig
```kconfig
if TARGET_IMX8MQ_QEI_EPAQ9710

config SYS_BOARD
	default "imx8mq_qei_epaq9710"

config SYS_VENDOR
	default "qei"

config SYS_CONFIG_NAME
	default "imx8mq_qei_epaq9710"

config IMX_CONFIG
	default "arch/arm/mach-imx/imx8m/imximage.cfg"

source "board/freescale/common/Kconfig"

endif
```
